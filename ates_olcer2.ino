/* orhan akgün tarafından 1 ekim 2020 tarihinde yapılmışıtr.
 *  temassız ateş ölçer
 */

#include <Adafruit_GFX.h>
#include <Adafruit_SSD1306.h>
#include <Wire.h>
#include <Adafruit_MLX90614.h>
#include <Fonts/FreeMonoBold18pt7b.h> 



Adafruit_SSD1306 display(128, 64);           
Adafruit_MLX90614 mlx = Adafruit_MLX90614();  


const unsigned char PROGMEM frame0 [] = {0x00, 0x00, 0x00, 0x00, 0x00, 0x00, 0x00, 0x00, 0x00, 0x00, 0x00, 0x00, 0x00,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 0x00, 0x00};









int YESIL=2;
int KIRMIZI=7;

float okuma[30];
float toplam ;
float sicaklik ;

void setup() {  
 
   pinMode(YESIL,OUTPUT);    
   pinMode(KIRMIZI,OUTPUT); 
  
  
   
  delay(100);  

  display.begin(SSD1306_SWITCHCAPVCC, 0x3C);  
  display.clearDisplay(); 
  display.setTextColor(WHITE);  
  mlx.begin();  


}


int xx =42;
int yy=20;
int tt=0;



void loop() {
  display.clearDisplay();


toplam=0;
for (int i=0; i<30; i++)
{
  float deger =mlx.readObjectTempC();
okuma[i]= deger *1;
toplam = toplam + okuma[i];
delay (5);
}
sicaklik = toplam / 30.0;

  if(sicaklik>30){
  display.clearDisplay(); 
  display.setFont();
  display.setCursor(10,10);  // (x,y)
  display.println("VUCUT SICAKLIGINIZ");  // Text or value to print
  display.setCursor(14,2);  // (x,y)
  display.println(".");  // Text or value to print
  display.setCursor(17,2);  // (x,y)
  display.println(".");  // Text or value to print
  display.setCursor(88,4);  // (x,y)
  display.println("-");  // Text or value to print
  
  display.setFont(&FreeMonoBold18pt7b);  // Set a custom font
  display.setCursor(10,55);  // (x,y)
  display.println(sicaklik,1);
   display.setCursor(100,55);  // (x,y)
  display.println("C");  // Text or value to print
  display.setCursor(88,37);  // (x,y)
  display.println(".");  // Text or value to print 
  
  }

  if(mlx.readObjectTempC()<=30){
 

display.clearDisplay(); 
  display.setFont();
  display.setCursor(10,10);  // (x,y)
  display.println("MASKEMIZI TAKALIM");  // Text or value to print
//display.clearDisplay();
display.drawBitmap(xx, yy,frame0,48,48, 1);
display.display();
delay(tt);



  }




 
   
  if((sicaklik)>=32 && (sicaklik)<=37  ){
    digitalWrite(YESIL,HIGH);
   digitalWrite(KIRMIZI,LOW);
  }
  else if((sicaklik)>37) {
     digitalWrite(KIRMIZI,HIGH);
     digitalWrite(YESIL,LOW);
     
  }
  else if((sicaklik)>38) {
     digitalWrite(KIRMIZI,HIGH);
     digitalWrite(YESIL,LOW);
      
  }
else  {
     digitalWrite(KIRMIZI,LOW);
     digitalWrite(YESIL,LOW);
}
 
  display.display();

}
